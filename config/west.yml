## config/west.yml
```yaml
manifest:
  remotes:
    - name: zmkfirmware
      url-base: https://github.com/zmkfirmware
    - name: nice_view
      url-base: https://github.com/nice_view
  projects:
    - name: zmk
      remote: zmkfirmware
      revision: main
      import: app/west.yml
    - name: corne_nice_view
      remote: nice_view
      revision: main
      path: shields/corne_nice_view
  self:
    path: config
```

## shields/corne_nice_view/left/Kconfig
```kconfig
#include "splitkb_aurora_corne_left/shield.dtsi"
#include "nice_view_adapter/shield.dtsi"
#include "nice_view/shield.dtsi"

config ZMK_KEYBOARD_NAME
    default "Corne Nice View Left"

config ZMK_KEYBOARD_SPLIT
    default y
```

## shields/corne_nice_view/right/Kconfig
```kconfig
config ZMK_KEYBOARD_NAME
    default "Corne Nice View Right"

config ZMK_KEYBOARD_SPLIT
    default y
```
